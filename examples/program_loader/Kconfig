## examples/program_loader/Kconfig
```kconfig
#
# For a description of the syntax of this configuration file,
# see the file kconfig-language.txt in the NuttX tools repository.
#

config EXAMPLES_PROGRAM_LOADER
	bool "Linux program loading example"
	default n
	depends on !DISABLE_SIGNALS && !DISABLE_PTHREAD
	---help---
		Enable the Linux program loading example

if EXAMPLES_PROGRAM_LOADER

config EXAMPLES_PROGRAM_LOADED_STACKSIZE
	int "Program stack size"
	default 0x400000
	---help---
		Size of the stack used to create the ostest task.  Default is 4MiB.

endif # EXAMPLES_OSTEST
```
